## config/west.yml
```yaml
manifest:
  remotes:
    - name: zmkfirmware
      url-base: https://github.com/zmkfirmware
    - name: refil
      url-base: https://github.com/refil
    - name: KinesisCorporation
      url-base: https://github.com/kinesiscorporation
    - name: urob
      url-base: https://github.com/urob
    # Additional modules containing boards/shields/custom code can be listed here as well
    # See https://docs.zephyrproject.org/3.2.0/develop/west/manifest.html#projects
  projects:
    - name: zmk
      remote: refil
      revision: disable-endpoint-fallback
      import: app/west.yml
    - name: MWave-zephyr-module
      remote: KinesisCorporation
      import: config/west.yml
      revision: main
    - name: zmk-settings-reset-bootloader-module
      remote: refil
      revision: main
    - name: zmk-helpers
      remote: urob
      revision: main
  self:
    path: config
```
